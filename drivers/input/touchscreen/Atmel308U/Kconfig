## drivers/input/touchscreen/Atmel308U/Kconfig
```kconfig
config TOUCHSCREEN_ATMEL308U
	bool "ATMEL A308U touchpanel driver"
	depends on CONFIG_INPUT_TOUCHSCREEN
	default n
```

## drivers/misc/fingerprint/Kconfig
```kconfig
config FINGERPRINT
	tristate "Fingerprint driver support"
	help
	  Say Y here to enable goodix fingerprint driver support!
source "drivers/misc/fingerprint/goodix/Kconfig"
source "drivers/misc/fingerprint/fpc/Kconfig"
```

## drivers/platform/xiaomi/Kconfig
```kconfig
comment "Xiaomi Optimization Features"

config PERF_HUMANTASK
	bool "Xiaomi's perf humantask feature"
	depends on MACH_XIAOMI
	help
	  Support for Xiaomi's perf humantask feature.
```
